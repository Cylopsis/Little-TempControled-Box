## Kconfig
```kconfig
mainmenu "RT-Thread Configuration"

BSP_DIR := .

RTT_DIR := ./rt-thread-5.2.1

PKGS_DIR := packages

config SOC_MCX
    bool
    select ARCH_ARM_CORTEX_M33
    default y

source "$(RTT_DIR)/Kconfig"
osource "$PKGS_DIR/Kconfig"
rsource "Libraries/Kconfig"
rsource "board/Kconfig"
rsource "applications/Kconfig"
```

## applications/Kconfig
```kconfig
menu "Application Configuration"
    menu "Fan Configuration"
        config PKG_USING_YS4028B12H
            bool "Enable YS4028B12H Fan Driver"
            select RT_USING_PWM
            default y
        
        config PKG_USING_YS4028B12H_PWM_DEV_NAME
            string "YS4028B12H PWM Device Name"
            default "pwm0"
            depends on PKG_USING_YS4028B12H
            help
                Set the PWM device name for the YS4028B12H fan.

        config PKG_USING_YS4028B12H_PWM_CHANNEL
            int "YS4028B12H PWM Channel"
            default 0
            depends on PKG_USING_YS4028B12H
            help
                Set the PWM channel for the YS4028B12H fan.

        config PKG_USING_YS4028B12H_PERIOD
            int "YS4028B12H PWM Period"
            default 20000
            depends on PKG_USING_YS4028B12H
            help
                Set the PWM period for the YS4028B12H fan in microseconds.
        
        config PKG_USING_YS4028B12H_DEFAULT_PAULSE
            int "YS4028B12H Default Pulse Width"
            default 1500
            depends on PKG_USING_YS4028B12H
            help
                Set the default pulse width for the YS4028B12H fan in microseconds. 
    
    endmenu
    menu "MOS-PTC Configuration"
        config APP_PTC_PWM_DEV_NAME
            string "MOS-PTC PWM Device Name"
            default "pwm0"
            help
                Set the PWM device name for the MOS-PTC heater.
        config APP_PTC_PWM_CHANNEL
            int "MOS-PTC PWM Channel"
            default 1
            help
                Set the PWM channel for the MOS-PTC heater.
        config APP_PTC_FREQUENCY
            int "MOS-PTC PWM Frequency  (Hz)"
            default 2000
            help
                Set the PWM frequency for the MOS-PTC heater in Hertz.
        config PTC_MAX_SAFE_TEMP
            int "MOS-PTC Maximum Safe Temperature (°C)"
            default 110
            help
                Set the maximum safe operating temperature for the MOS-PTC heater in degrees Celsius.
    endmenu
    menu "WLAN Configuration"
        config APP_WLAN_SSID
            string "WLAN SSID"
            default "142A_SecurityPlus"
            help
                Set the SSID for the WLAN connection.
        config APP_WLAN_PASSWORD
            string "WLAN Password"
            default "142a8888"
            help
                Set the password for the WLAN connection.
    endmenu
endmenu
```
